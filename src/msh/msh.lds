/******************************************************************************/
/*                                                                            */
/* srv/msh/msh.lds                                                            */
/*                                                                 2020/05/18 */
/* Copyright (C) 2018-2020 Mochi.                                             */
/*                                                                            */
/******************************************************************************/
ENTRY( main )

SECTIONS {
    . = 0x40000000;
    .text   : { *( .text   ) }
    .rodata : { *( .rodata ) }
    .data   : { *( .data   ) }
    .bss    : { *( .bss    ) }
}


/******************************************************************************/
